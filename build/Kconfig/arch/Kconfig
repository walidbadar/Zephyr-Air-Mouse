## build/Kconfig/arch/Kconfig
```kconfig
# Load Zephyr Arch Kconfig descriptions.
osource "C:/Users/walid/zephyrproject/zephyr/arch/x86/Kconfig"
osource "C:/Users/walid/zephyrproject/zephyr/arch/xtensa/Kconfig"
osource "C:/Users/walid/zephyrproject/zephyr/arch/sparc/Kconfig"
osource "C:/Users/walid/zephyrproject/zephyr/arch/riscv/Kconfig"
osource "C:/Users/walid/zephyrproject/zephyr/arch/posix/Kconfig"
osource "C:/Users/walid/zephyrproject/zephyr/arch/nios2/Kconfig"
osource "C:/Users/walid/zephyrproject/zephyr/arch/mips/Kconfig"
osource "C:/Users/walid/zephyrproject/zephyr/arch/arm64/Kconfig"
osource "C:/Users/walid/zephyrproject/zephyr/arch/arm/Kconfig"
osource "C:/Users/walid/zephyrproject/zephyr/arch/arc/Kconfig"
```

## build/Kconfig/boards/Kconfig
```kconfig
# Load Zephyr board Kconfig descriptions.
osource "C:/Users/walid/zephyrproject/zephyr/boards/st/stm32f3_disco/Kconfig"
```

## build/Kconfig/boards/Kconfig.defconfig
```kconfig
# Load Zephyr board defconfig descriptions.
osource "C:/Users/walid/zephyrproject/zephyr/boards/st/stm32f3_disco/Kconfig.defconfig"
```

## build/Kconfig/boards/Kconfig.stm32f3_disco
```kconfig
# Load board Kconfig descriptions.
osource "C:/Users/walid/zephyrproject/zephyr/boards/st/stm32f3_disco/Kconfig.stm32f3_disco"
```
